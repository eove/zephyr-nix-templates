## CMakeLists.txt
```
# This file is property of EOVE SAS.

# This defines the minimum version of CMake this config is compliant with.
cmake_minimum_required(VERSION 3.25)

# Load the Zephyr package and search from the zephyr directory.
find_package(Zephyr REQUIRED HINTS "$ENV{ZEPHYR_BASE}")

# Declare the CMake project.
project(app)

# Headers.
#target_include_directories(app PRIVATE include/)

# And its sources.
target_sources(app PRIVATE
  # Entry point
  src/main.c
)
```

## west.yml
```
manifest:
  defaults:
    remote: zephyrproject-rtos
  
  remotes:
    - name: zephyrproject-rtos
      url-base: https://github.com/zephyrproject-rtos

  projects:
    - name: zephyr
      remote: zephyrproject-rtos
      revision: v4.0.0
      clone-depth: 1
      import:
        name-allowlist:
          - cmsis
          - hal_stm32

  self:
    path: app
```

## prj.conf
```kconfig
# Enable CONSOLE
CONFIG_CONSOLE=y
```

## src/main.c
```c
#include <zephyr/kernel.h>

int main() { printk("Hello World!"); }
```
